## CMakeLists.txt
```
#
# Copyright (c) 2020 Nordic Semiconductor ASA
#
# SPDX-License-Identifier: LicenseRef-BSD-5-Clause-Nordic
#

cmake_minimum_required(VERSION 3.13.1)

find_package(Zephyr REQUIRED HINTS $ENV{ZEPHYR_BASE})

project("Zigbee coordinator")

# NORDIC SDK APP START
target_sources(app PRIVATE
  src/main.c
  src/thran.c
)
# NORDIC SDK APP END
```

## sample.yaml
```
sample:
  name: Zigbee Light control
  description: Zigbee Light control - coordinator sample
tests:
  samples.zigbee.network_coordinator:
    platform_whitelist: nrf52840dk_nrf52840
    harness: zigbee
    tags: zigbee
  zigbee.network_coordinator:
    build_only: true
    build_on_all: true
    platform_whitelist: nrf52840dk_nrf52840 nrf52833dk_nrf52833
    tags: ci_build
```

## prj.conf
```kconfig
#
# Copyright (c) 2020 Nordic Semiconductor ASA
#
# SPDX-License-Identifier: LicenseRef-BSD-5-Clause-Nordic
#

CONFIG_NCS_SAMPLES_DEFAULTS=y

CONFIG_UART_INTERRUPT_DRIVEN=y
CONFIG_SERIAL=y
CONFIG_GPIO=y

# Make sure printk is not printing to the UART console
CONFIG_CONSOLE=y
CONFIG_UART_CONSOLE=y

CONFIG_HEAP_MEM_POOL_SIZE=2048
CONFIG_MAIN_THREAD_PRIORITY=7

CONFIG_ZIGBEE=y
CONFIG_ZIGBEE_ROLE_COORDINATOR=y

# Enable bonding
CONFIG_NVS=y

# Enable DK LED and Buttons library
CONFIG_DK_LIBRARY=y

# This example requires more workqueue stack
CONFIG_SYSTEM_WORKQUEUE_STACK_SIZE=2048

# Enable nRF ECB driver
CONFIG_CRYPTO=y
CONFIG_CRYPTO_NRF_ECB=y

# Cryptocell is not supported through CSPRNG driver API: NCSDK-4813
CONFIG_ENTROPY_CC310=n

#Networking
CONFIG_NET_IPV6_MLD=n
CONFIG_NET_IPV6_NBR_CACHE=n
CONFIG_NET_IPV6_RA_RDNSS=n
CONFIG_NET_IP_ADDR_CHECK=n
CONFIG_NET_UDP=n
#CONFIG_NET_PKT_TX_COUNT=10

#logging
CONFIG_ZBOSS_TRACE_LOG_LEVEL_DBG=y
CONFIG_ZBOSS_TRACE_MASK=0x0448

#logger
CONFIG_LOG_MINIMAL=n
CONFIG_LOG_PROCESS_THREAD_SLEEP_MS=500
CONFIG_LOG_PROCESS_THREAD_STACK_SIZE=2000
CONFIG_LOG_BUFFER_SIZE=4000
#CONFIG_LOG_BACKEND_RTT=n
```

## src/main.c
```c
/*
 * Copyright (c) 2020 Nordic Semiconductor ASA
 *
 * SPDX-License-Identifier: LicenseRef-BSD-5-Clause-Nordic
 */

/** @file
 *  @brief Simple Zigbee network coordinator implementation
 */

#include <zephyr.h>
#include <device.h>
#include <logging/log.h>
#include <dk_buttons_and_leds.h>

#include <zboss_api.h>
#include <zb_mem_config_max.h>
#include <zb_error_handler.h>
#include <zigbee_helpers.h>
#include <zb_nrf_platform.h>


#define RUN_STATUS_LED          DK_LED1
#define RUN_LED_BLINK_INTERVAL  1000

/* LED indicating that network is opened for new nodes */
#define ZIGBEE_NETWORK_STATE_LED          DK_LED3

/* Button which reopens the Zigbee Network */
#define KEY_ZIGBEE_NETWORK_REOPEN         DK_BTN1_MSK

/**
 * If set to ZB_TRUE then device will not open the network
 * after forming or reboot.
 */
#define ZIGBEE_MANUAL_STEERING            ZB_FALSE

#define ZIGBEE_PERMIT_LEGACY_DEVICES      ZB_FALSE

#ifndef ZB_COORDINATOR_ROLE
#error Define ZB_COORDINATOR_ROLE to compile coordinator source code.
#endif

LOG_MODULE_REGISTER(app);


/**@brief Callback used in order to visualise network steering period.
 *
 * @param[in]   param   Not used. Required by callback type definition.
 */
static void steering_finished(zb_uint8_t param)
{
	ARG_UNUSED(param);
	LOG_INF("Network steering finished");
	dk_set_led_off(ZIGBEE_NETWORK_STATE_LED);
}

/**@brief Callback for button events.
 *
 * @param[in]   button_state  Bitmask containing buttons state.
 * @param[in]   has_changed   Bitmask containing buttons
 *                            that has changed their state.
 */
static void button_changed(uint32_t button_state, uint32_t has_changed)
{
	/* Calculate bitmask of buttons that are pressed
	 * and have changed their state.
	 */
	uint32_t buttons = button_state & has_changed;
	zb_bool_t comm_status;

	if (buttons & KEY_ZIGBEE_NETWORK_REOPEN) {
		(void)(ZB_SCHEDULE_APP_ALARM_CANCEL(
			steering_finished, ZB_ALARM_ANY_PARAM));

		comm_status = bdb_start_top_level_commissioning(
			ZB_BDB_NETWORK_STEERING);
		if (comm_status) {
			LOG_INF("Top level comissioning restated");
		} else {
			LOG_INF("Top level comissioning hasn't finished yet!");
		}
	}
}

/**@brief Function for initializing LEDs and Buttons. */
static void configure_gpio(void)
{
	int err;

	err = dk_buttons_init(button_changed);
	if (err) {
		LOG_ERR("Cannot init buttons (err: %d)", err);
	}

	err = dk_leds_init();
	if (err) {
		LOG_ERR("Cannot init LEDs (err: %d)", err);
	}
}

/**@brief Zigbee stack event handler.
 *
 * @param[in]   bufid   Reference to the Zigbee stack buffer
 *                      used to pass signal.
 */
void zboss_signal_handler(zb_bufid_t bufid)
{
	/* Read signal description out of memory buffer. */
	zb_zdo_app_signal_hdr_t *sg_p = NULL;
	zb_zdo_app_signal_type_t sig = zb_get_app_signal(bufid, &sg_p);
	zb_ret_t status = ZB_GET_APP_SIGNAL_STATUS(bufid);
	zb_ret_t zb_err_code;
	zb_bool_t comm_status;
	zb_time_t timeout_bi;

	switch (sig) {
	case ZB_BDB_SIGNAL_DEVICE_REBOOT:
		/* BDB initialization completed after device reboot,
		 * use NVRAM contents during initialization.
		 * Device joined/rejoined and started.
		 */
		if (status == RET_OK) {
			if (ZIGBEE_MANUAL_STEERING == ZB_FALSE) {
				LOG_INF("Start network steering");
				comm_status = bdb_start_top_level_commissioning(
					ZB_BDB_NETWORK_STEERING);
				ZB_COMM_STATUS_CHECK(comm_status);
			} else {
				LOG_INF("Coordinator restarted successfully");
			}
		} else {
			LOG_ERR("Failed to initialize Zigbee stack using NVRAM data (status: %d)",
				status);
		}
		break;

	case ZB_BDB_SIGNAL_STEERING:
		if (status == RET_OK) {
			if (ZIGBEE_PERMIT_LEGACY_DEVICES == ZB_TRUE) {
				LOG_INF("Allow pre-Zigbee 3.0 devices to join the network");
				zb_bdb_set_legacy_device_support(1);
			}

			/* Schedule an alarm to notify about the end
			 * of steering period
			 */
			LOG_INF("Network steering started");
			zb_err_code = ZB_SCHEDULE_APP_ALARM(
				steering_finished, 0,
				ZB_TIME_ONE_SECOND *
					ZB_ZGP_DEFAULT_COMMISSIONING_WINDOW);
			ZB_ERROR_CHECK(zb_err_code);
		}
		break;

	case ZB_ZDO_SIGNAL_DEVICE_ANNCE: {
		zb_zdo_signal_device_annce_params_t *dev_annce_params =
			ZB_ZDO_SIGNAL_GET_PARAMS(
				sg_p, zb_zdo_signal_device_annce_params_t);

		LOG_INF("New device commissioned or rejoined (short: 0x%04hx)",
			dev_annce_params->device_short_addr);

		zb_err_code = ZB_SCHEDULE_APP_ALARM_CANCEL(steering_finished,
							   ZB_ALARM_ANY_PARAM);
		if (zb_err_code == RET_OK) {
			LOG_INF("Joining period extended.");
			zb_err_code = ZB_SCHEDULE_APP_ALARM(
				steering_finished, 0,
				ZB_TIME_ONE_SECOND *
					ZB_ZGP_DEFAULT_COMMISSIONING_WINDOW);
			ZB_ERROR_CHECK(zb_err_code);
		}
	} break;

	default:
		/* Call default signal handler. */
		ZB_ERROR_CHECK(zigbee_default_signal_handler(bufid));
		break;
	}

	/* Update network status LED */
	if (ZB_JOINED() &&
	    (ZB_SCHEDULE_GET_ALARM_TIME(steering_finished, ZB_ALARM_ANY_PARAM,
					&timeout_bi) == RET_OK)) {
		dk_set_led_on(ZIGBEE_NETWORK_STATE_LED);
	} else {
		dk_set_led_off(ZIGBEE_NETWORK_STATE_LED);
	}

	/*
	 * All callbacks should either reuse or free passed buffers.
	 * If bufid == 0, the buffer is invalid (not passed).
	 */
	if (bufid) {
		zb_buf_free(bufid);
	}
}

void error(void)
{
	dk_set_leds_state(DK_ALL_LEDS_MSK, DK_NO_LEDS_MSK);

	while (true) {
		/* Spin for ever */
		k_sleep(K_MSEC(1000));
	}
}

void main(void)
{
	int blink_status = 0;

	LOG_INF("Starting ZBOSS Coordinator example");

	/* Initialize */
	configure_gpio();

	/* Start Zigbee default thread */
	zigbee_enable();

	LOG_INF("ZBOSS Coordinator example started");

	while (1) {
		dk_set_led(RUN_STATUS_LED, (++blink_status) % 2);
		//LOG_INF("Status LED: %d", blink_status % 2);
		k_sleep(K_MSEC(RUN_LED_BLINK_INTERVAL));
	}
}
```

## src/thran.c
```c
#include "thran.h"
#include <string.h>
#include <kernel.h>

struct thread_info {
	char name[33];
	size_t stack_size;
	size_t stack_used;
};

#define THREAD_ITEMS 15

struct thread_info thread_info_arr[THREAD_ITEMS] = {};
int thread_info_arr_size = 0;

void update_thread_item(struct thread_analyzer_info *info)
{
	int i;
	int idx = -1;

	if (thread_info_arr_size >= THREAD_ITEMS) {
		printk("thread_info_arr full!\n");
		return;
	}

	for (i = 0; i < thread_info_arr_size; i++) {
		if (strcmp(info->name, thread_info_arr[i].name) == 0) {
			idx = i;
			break;
		}
	}

	if (idx == -1) {
		idx = thread_info_arr_size;
		thread_info_arr_size++;
	}

	strcpy(thread_info_arr[idx].name, info->name);
	if (thread_info_arr[idx].stack_size < info->stack_size) {
		thread_info_arr[idx].stack_size = info->stack_size;
	}
	if (thread_info_arr[idx].stack_used < info->stack_used) {
		thread_info_arr[idx].stack_used = info->stack_used;
	}
}

void list_thread_items(void)
{
	int i;

	for (i = 0; i < thread_info_arr_size; i++) {
		printk("%s: %d, %d\n",
			thread_info_arr[i].name,
			thread_info_arr[i].stack_size,
			thread_info_arr[i].stack_used);
	}
	printk("\n");
}
```

## src/thran.h
```c
/*
 * thran.h
 *
 *  Created on: 9 lip 2020
 *      Author: mafa
 */
#ifndef NRF_SAMPLES_ZIGBEE_NETWORK_COORDINATOR_SRC_THRAN_H_
#define NRF_SAMPLES_ZIGBEE_NETWORK_COORDINATOR_SRC_THRAN_H_

#include <debug/thread_analyzer.h>
#include <string.h>

void update_thread_item(struct thread_analyzer_info *info);
void list_thread_items(void);

#endif /* NRF_SAMPLES_ZIGBEE_NETWORK_COORDINATOR_SRC_THRAN_H_ */
```
