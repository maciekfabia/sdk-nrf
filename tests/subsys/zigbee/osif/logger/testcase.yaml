## tests/subsys/zigbee/osif/logger/testcase.yaml
```yaml
tests:
  zigbee.osif.logger:
    platform_whitelist: nrf52840_pca10056
    tags: osif_logger
```

## tests/subsys/zigbee/osif/timer/testcase.yaml
```yaml
tests:
  zigbee.osif.timer:
    platform_whitelist: nrf52840_pca10056
    tags: zigbee_osif
```

## tests/subsys/zigbee/zboss_api/callback_api/testcase.yaml
```yaml
tests:
  zigbee.zboss_api.callback_api:
    platform_whitelist: nrf52840_pca10056
    tags: zboss_api_callback
```
